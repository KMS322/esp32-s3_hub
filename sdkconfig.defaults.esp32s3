## sdkconfig.defaults.esp32s3
```kconfig
# ESP32-S3 N16R8 hub: mains-powered, WiFi + BLE scan + multi-connection + MQTT/HTTPS.
# Strategy: enable 8MB Octal PSRAM and route WiFi/lwIP/BT/TLS through SPIRAM-capable malloc,
# instead of shrinking SSL/BT to fit internal SRAM only.
#
# If esp_psram_init panics: verify real N16R8 module, flash mode (OPI), try 40MHz (below).
#
CONFIG_IDF_TARGET="esp32s3"
CONFIG_ESPTOOLPY_FLASHSIZE_16MB=y
CONFIG_ESPTOOLPY_FLASHSIZE="16MB"

# PSRAM (N16R8: Octal 8MB, conservative 40MHz)
CONFIG_SPIRAM=y
CONFIG_SPIRAM_MODE_OCT=y
# CONFIG_SPIRAM_MODE_QUAD is not set
CONFIG_SPIRAM_TYPE_AUTO=y
CONFIG_SPIRAM_SPEED_40M=y
# CONFIG_SPIRAM_SPEED_80M is not set
CONFIG_SPIRAM_BOOT_INIT=y
CONFIG_SPIRAM_USE_MALLOC=y
CONFIG_SPIRAM_TRY_ALLOCATE_WIFI_LWIP=y
# Lower reserve -> larger contiguous internal blocks for BTU/bt_workqueue after controller init.
CONFIG_SPIRAM_MALLOC_RESERVE_INTERNAL=2048
# Smaller threshold -> more WiFi/LWIP buffers go to PSRAM; keep internal for BT stacks/HCI.
CONFIG_SPIRAM_MALLOC_ALWAYSINTERNAL=2048

# Balance: enough WiFi buffers to avoid wifi:m f null spam + stable STA under BLE load.
CONFIG_ESP_WIFI_STATIC_RX_BUFFER_NUM=6
CONFIG_ESP_WIFI_DYNAMIC_RX_BUFFER_NUM=10
CONFIG_ESP_WIFI_STATIC_TX_BUFFER_NUM=10
CONFIG_ESP_WIFI_CACHE_TX_BUFFER_NUM=10

CONFIG_BT_ENABLED=y
CONFIG_BT_BLE_42_FEATURES_SUPPORTED=y
CONFIG_BT_ACL_CONNECTIONS=5
CONFIG_BT_ALLOCATION_FROM_SPIRAM_FIRST=y
CONFIG_BT_GATTC_MAX_CACHE_CHAR=10

CONFIG_ESP_DEFAULT_CPU_FREQ_MHZ_240=y
CONFIG_ESP_DEFAULT_CPU_FREQ_MHZ=240
CONFIG_BT_BTC_TASK_STACK_SIZE=8192
CONFIG_BT_BTU_TASK_STACK_SIZE=8192

# CONFIG_MBEDTLS_INTERNAL_MEM_ALLOC is not set
CONFIG_MBEDTLS_DEFAULT_MEM_ALLOC=y

CONFIG_MBEDTLS_ASYMMETRIC_CONTENT_LEN=y
CONFIG_MBEDTLS_SSL_IN_CONTENT_LEN=4096
CONFIG_MBEDTLS_SSL_OUT_CONTENT_LEN=2048
CONFIG_MBEDTLS_DYNAMIC_BUFFER=y
CONFIG_MBEDTLS_CERTIFICATE_BUNDLE_DEFAULT_CMN=y
CONFIG_MBEDTLS_CERTIFICATE_BUNDLE_MAX_CERTS=64

CONFIG_MQTT_USE_CUSTOM_CONFIG=y
CONFIG_MQTT_OUTBOX_DATA_ON_EXTERNAL_MEMORY=y
# Avoid starving PING/DATA when many events queue (default 1 can stall keepalive).
CONFIG_MQTT_EVENT_QUEUE_SIZE=20
# Under Wi-Fi+BLE load, default 6144 can overflow; 8192 is safer for esp-mqtt client.
CONFIG_MQTT_TASK_STACK_SIZE=8192
CONFIG_LWIP_TCPIP_RECVMBOX_SIZE=24
```
